## boards/nucleo-h723zg/Kconfig
```kconfig
# Copyright (c) 2024 Prime Controls Inc.
#
# This file is subject to the terms and conditions of the GNU Lesser
# General Public License v2.1. See the file LICENSE in the top level
# directory for more details.
#

config BOARD
    default "nucleo-h723zg" if BOARD_NUCLEO_H723ZG

config BOARD_NUCLEO_H723ZG
    bool
    default y
    select BOARD_COMMON_NUCLEO144
    select CPU_MODEL_STM32H723ZG

source "$(RIOTBOARD)/common/nucleo144/Kconfig"
```
